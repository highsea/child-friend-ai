#include "display.h"
#include "esp_log.h"
#include "driver/spi_master.h"
#include "board.h"
#include <string.h>

static const char *TAG = "display";

static spi_device_handle_t spi;
static display_state_t current_state = DISPLAY_STATE_STARTING;

static const uint8_t st7735_init_seq[] = {
    0x01, 0, 0x80, 150,
    0x11, 0, 0x80, 255,
    0x21, 0, 0x80, 10,
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    0x29, 0, 0x80, 0,
};

static const uint8_t font_8x16[][16] = {
    {0x00,0x00,0x00,0x00,0x00,0x00,0x00,0x00,0x00,0x00,0x00,0x00,0x00,0x00,0x00,0x00},
    {0x00,0x00,0x00,0xE0,0x10,0x08,0x08,0x08,0x08,0x10,0xE0,0x00,0x00,0x00,0x00,0x00},
    {0x00,0x00,0x00,0x10,0x10,0x10,0x10,0x10,0x10,0x10,0x10,0x00,0x00,0x00,0x00,0x00},
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    {0x00,0x00,0x00,0x00,0x00,0x00,0x00,0x00,0x00,0x00,0x00,0x00,0x00,0x00,0x00,0x00},
};

static void st7735_write_command(uint8_t cmd)
{
    gpio_set_level(LCD_DC_GPIO, 0);
    spi_transaction_t t = {
        .length = 8,
        .tx_data = {cmd},
        .flags = SPI_TRANS_USE_TXDATA,
    };
    spi_device_polling_transmit(spi, &t);
}

static void st7735_write_data(uint8_t data)
{
    gpio_set_level(LCD_DC_GPIO, 1);
    spi_transaction_t t = {
        .length = 8,
        .tx_data = {data},
        .flags = SPI_TRANS_USE_TXDATA,
    };
    spi_device_polling_transmit(spi, &t);
}

static void st7735_set_addr_window(uint16_t x0, uint16_t y0, uint16_t x1, uint16_t y1)
{
    st7735_write_command(0x2A);
    st7735_write_data(x0 >> 8);
    st7735_write_data(x0 & 0xFF);
    st7735_write_data(x1 >> 8);
    st7735_write_data(x1 & 0xFF);

    st7735_write_command(0x2B);
    st7735_write_data(y0 >> 8);
    st7735_write_data(y0 & 0xFF);
    st7735_write_data(y1 >> 8);
    st7735_write_data(y1 & 0xFF);

    st7735_write_command(0x2C);
}

void display_init(void)
{
    ESP_LOGI(TAG, "Initializing ST7735 display...");

    spi_bus_config_t buscfg = {
        .mosi_io_num = LCD_MOSI_GPIO,
        .sclk_io_num = LCD_SCK_GPIO,
        .quadwp_io_num = -1,
        .quadhd_io_num = -1,
        .max_transfer_sz = 4096,
    };

    ESP_ERROR_CHECK(spi_bus_initialize(SPI2_HOST, &buscfg, SPI_DMA_CH_AUTO));

    spi_device_interface_config_t devcfg = {
        .clock_speed_hz = 40000000,
        .mode = 0,
        .spics_io_num = LCD_CS_GPIO,
        .queue_size = 7,
    };

    ESP_ERROR_CHECK(spi_bus_add_device(SPI2_HOST, &devcfg, &spi));

    gpio_set_level(LCD_RST_GPIO, 0);
    vTaskDelay(pdMS_TO_TICKS(10));
    gpio_set_level(LCD_RST_GPIO, 1);
    vTaskDelay(pdMS_TO_TICKS(120));

    for (int i = 0; i < sizeof(st7735_init_seq);) {
        uint8_t cmd = st7735_init_seq[i++];
        uint8_t delay = st7735_init_seq[i++];
        uint8_t num_args = st7735_init_seq[i++];
        st7735_write_command(cmd);
        for (int j = 0; j < num_args; j++) {
            st7735_write_data(st7735_init_seq[i++]);
        }
        if (delay) {
            vTaskDelay(pdMS_TO_TICKS(delay));
        }
    }

    st7735_write_command(0x11);
    vTaskDelay(pdMS_TO_TICKS(120));
    st7735_write_command(0x29);

    display_clear();
    ESP_LOGI(TAG, "Display initialized");
}

static void draw_char(uint16_t x, uint16_t y, char c, uint16_t fg_color, uint16_t bg_color)
{
    if (c < 32 || c > 126) {
        c = '?';
    }

    const uint8_t *char_data = font_8x16[c - 32];

    st7735_set_addr_window(x, y, x + 7, y + 15);
    gpio_set_level(LCD_DC_GPIO, 1);

    for (int i = 0; i < 16; i++) {
        uint8_t row = char_data[i];
        for (int j = 0; j < 8; j++) {
            uint16_t color = (row & 0x80) ? fg_color : bg_color;
            uint8_t color_bytes[2] = {color >> 8, color & 0xFF};
            spi_device_polling_transmit(spi, &(spi_transaction_t){
                .length = 16,
                .tx_buffer = color_bytes,
            });
            row <<= 1;
        }
    }
}

void display_show_state(display_state_t state)
{
    current_state = state;
    display_clear();

    const char *text = "";
    uint16_t bg_color = 0x0000;
    uint16_t text_color = 0xFFFF;

    switch (state) {
    case DISPLAY_STATE_STARTING:
        text = "Starting...";
        bg_color = 0x0010;
        break;
    case DISPLAY_STATE_IDLE:
        text = "Say: Hi";
        bg_color = 0x0000;
        text_color = 0x07E0;
        break;
    case DISPLAY_STATE_LISTENING:
        text = "Listening...";
        bg_color = 0x03E0;
        break;
    case DISPLAY_STATE_PROCESSING:
        text = "Thinking...";
        bg_color = 0x07E0;
        break;
    case DISPLAY_STATE_SPEAKING:
        text = "Speaking...";
        bg_color = 0x07FF;
        break;
    case DISPLAY_STATE_ERROR:
        text = "Error!";
        bg_color = 0xF800;
        break;
    }

    display_show_text_with_bg(text, text_color, bg_color);
}

void display_show_text_with_bg(const char *text, uint16_t fg_color, uint16_t bg_color)
{
    uint16_t x = 0;
    uint16_t y = 20;

    while (*text) {
        draw_char(x, y, *text, fg_color, bg_color);
        x += 8;
        if (x >= 160) {
            x = 0;
            y += 16;
        }
        text++;
    }
}

void display_show_text(const char *text)
{
    display_show_text_with_bg(text, 0xFFFF, 0x0000);
}

void display_clear(void)
{
    st7735_set_addr_window(0, 0, 159, 79);
    gpio_set_level(LCD_DC_GPIO, 1);

    uint8_t zeros[256] = {0};
    for (int i = 0; i < 80; i++) {
        for (int j = 0; j < 160 / 256; j++) {
            spi_device_polling_transmit(spi, &(spi_transaction_t){
                .length = 160 * 2,
                .tx_buffer = zeros,
            });
        }
    }
}
